## Kconfig
```kconfig
config ZMK_SETTINGS_RPC
    bool "Enable ZMK core settings RPC module"

if ZMK_SETTINGS_RPC

config ZMK_SETTINGS_RPC_STUDIO
    bool "Enable ZMK core settings custom Studio RPC"
    depends on ZMK_STUDIO

config ZMK_SPLIT_RELAY_EVENT
    bool "Enable event relay between central and peripheral for split keyboards"
    default y
    depends on ZMK_SPLIT
    help
      Enable relaying events between central and peripheral halves for split keyboards.
      This is required for propagating settings changes to peripheral keyboards.

config ZMK_SPLIT_RELAY_EVENT_TYPE_NAME_LEN
    int "Maximum length of relay event type name"
    default 32
    depends on ZMK_SPLIT_RELAY_EVENT

config ZMK_SPLIT_RELAY_EVENT_DATA_LEN
    int "Maximum length of relay event data"
    default 64
    depends on ZMK_SPLIT_RELAY_EVENT

endif
```

## tests/split-config/boards/shields/split_xiao/Kconfig.defconfig
```kconfig
if SHIELD_SPLIT_XIAO_RIGHT

config ZMK_KEYBOARD_NAME
    default "SPLITXIAO"

config ZMK_SPLIT_ROLE_CENTRAL
    def_bool y
endif

if SHIELD_SPLIT_XIAO_RIGHT || SHIELD_SPLIT_XIAO_LEFT
config ZMK_SPLIT
    def_bool y
endif
```

## tests/split-config/boards/shields/split_xiao/Kconfig.shield
```kconfig
config SHIELD_SPLIT_XIAO_LEFT
   def_bool $(shields_list_contains,split_xiao_left)

config SHIELD_SPLIT_XIAO_RIGHT
   def_bool $(shields_list_contains,split_xiao_right)
```

## tests/zmk-config/boards/shields/my_awesome_keyboard/Kconfig.defconfig
```kconfig
if SHIELD_MY_AWESOME_KEYBOARD

config ZMK_KEYBOARD_NAME
    default "MAK"

config ZMK_BLE
    def_bool n

config SETTINGS
    def_bool n

config MY_AWESOME_KEYBOARD_SPECIAL_FEATURE
    bool "Enable special feature for My Awesome Keyboard"

endif
```

## tests/zmk-config/boards/shields/my_awesome_keyboard/Kconfig.shield
```kconfig
config SHIELD_MY_AWESOME_KEYBOARD
    def_bool $(shields_list_contains,my_awesome_keyboard)
```
